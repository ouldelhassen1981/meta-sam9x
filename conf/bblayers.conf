## conf/bblayers.conf
```bitbake
# POKY_BBLAYERS_CONF_VERSION is increased each time build/conf/bblayers.conf
# changes incompatibly
POKY_BBLAYERS_CONF_VERSION = "2"

BBPATH = "${TOPDIR}"
BBFILES ?= ""
BSPDIR := "${@os.path.abspath(os.path.dirname(d.getVar('FILE', True)) + '/../..')}"

BBLAYERS ?= " \
  ${BSPDIR}/sources/poky/meta \
  ${BSPDIR}/poky/meta-poky \
  ${BSPDIR}/poky/meta-yocto-bsp \
  ${BSPDIR}/meta-openembedded/meta-oe \
  ${BSPDIR}/meta-openembedded/meta-networking \
  ${BSPDIR}/meta-openembedded/meta-webserver \
  ${BSPDIR}/meta-openembedded/meta-python \
  ${BSPDIR}/meta-openembedded/meta-initramfs \
  ${BSPDIR}/meta-atmel \
  ${BSPDIR}/meta-openembedded/meta-multimedia \
  ${BSPDIR}/meta-arm/meta-arm \
  ${BSPDIR}/meta-arm/meta-arm-toolchain \
  ${BSPDIR}/meta-rauc \
  ${BSPDIR}/meta-rauc-community/meta-rauc-atmel \
  "
```

## conf/layer.conf
```bitbake
# We have a conf and classes directory, add to BBPATH
BBPATH .= ":${LAYERDIR}"

# We have recipes-* directories, add to BBFILES
BBFILES += "${LAYERDIR}/recipes-*/*/*.bb \
            ${LAYERDIR}/recipes-*/*/*.bbappend"

BBFILE_COLLECTIONS += "meta-sam9x"
BBFILE_PATTERN_meta-sam9x = "^${LAYERDIR}/"
BBFILE_PRIORITY_meta-sam9x = "11"

LAYERDEPENDS_meta-sam9x = "core rauc atmel"
LAYERSERIES_COMPAT_meta-sam9x = "dunfell kirkstone"
```

## scripts/lib/wic/canned-wks/sdimage-A-B.wks
```
# short-description: Create SD card image
# long-description: Creates a partitioned SD card image.

#part / --source rootfs --ondisk mmcblk --fstype=ext4 --label root --align 4
part /boot --source bootimg-partition --ondisk mmcblk --fstype=vfat --label boot --active --align 4096 --size 100
part / --source rootfs --ondisk mmcblk --fstype=ext4 --label rootfs_A --align 4096
part / --source rootfs --ondisk mmcblk --fstype=ext4 --label rootfs_B --align 4096
part /data --fixed-size 100M --ondisk mmcblk --fstype=ext4 --label data --align 4096
```
